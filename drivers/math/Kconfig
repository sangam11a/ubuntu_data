## drivers/math/Kconfig
```kconfig
#
# For a description of the syntax of this configuration file,
# see the file kconfig-language.txt in the NuttX tools repository.
#

menu "MATH Acceleration Support"

config MATH_CORDIC
	bool "MATH CORDIC support"
	default n
	---help---
		This selection enables building of the "upper-half" CORDIC driver.
		See include/nuttx/math/cordic.h for further CORDIC driver information.



config MATH_FFT
	bool "MATH FFT support"
	default n
	---help---
		This selection enables building of the "upper-half" FFT driver.
		See include/nuttx/math/fft.h for further FFT driver information.

config MATH_MPI
	bool "MATH MPI support"
	default n
	---help---
		This selection enables building of the "upper-half" MPI driver.
		See include/nuttx/math/mpi.h for further MPI driver information.

endmenu # MATH Acceleration Information
```
